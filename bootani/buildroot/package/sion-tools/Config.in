## bootani/buildroot/package/sion-tools/Config.in
```kconfig
config BR2_PACKAGE_SION_TOOLS
	bool "sion-tools"
	depends on BR2_USE_MMU # openssh, avahi
	depends on BR2_TOOLCHAIN_HAS_THREADS # avahi, efivar
	depends on !BR2_STATIC_LIBS # avahi, efivar
	depends on BR2_PACKAGE_EFIVAR_ARCH_SUPPORTS
	select BR2_PACKAGE_OPENSSH
	select BR2_PACKAGE_OPENSSH_SERVER
	select BR2_PACKAGE_OPENSSH_KEY_UTILS
	select BR2_PACKAGE_AVAHI
	select BR2_PACKAGE_AVAHI_DAEMON
	select BR2_PACKAGE_WPA_SUPPLICANT
	select BR2_PACKAGE_WPA_SUPPLICANT_NL80211
	select BR2_PACKAGE_WPA_SUPPLICANT_WPA3
	select BR2_PACKAGE_WPA_SUPPLICANT_CLI
	select BR2_PACKAGE_IW
	select BR2_PACKAGE_WIRELESS_REGDB
	select BR2_PACKAGE_EFIBOOTMGR
	select BR2_PACKAGE_E2FSPROGS
	select BR2_PACKAGE_E2FSPROGS_RESIZE2FS
	select BR2_PACKAGE_UTIL_LINUX
	select BR2_PACKAGE_UTIL_LINUX_BINARIES # sfdisk, blkid
	select BR2_PACKAGE_UTIL_LINUX_PARTX
	help
	  Remote access and updates for a Sion machine:
	  - SSH (with SFTP) as root, over wired, USB or Wi-Fi Ethernet,
	    found on the network as <hostname>.local
	  - a persistent ext4 partition (SIONDATA) mounted on /data, with
	    an overlay copied over the root filesystem at boot
	  - "sion update": A/B updates of the boot image that boot the new
	    image once and keep it only if it comes up, otherwise the
	    machine falls back to the previous one

	  Settings come from sion/sion.conf on the boot disk's EFI
	  partition.

if BR2_PACKAGE_SION_TOOLS

config BR2_PACKAGE_SION_TOOLS_SPLIT_ROOT
	bool "system on SIONDATA, small early initramfs"
	depends on BR2_TARGET_ROOTFS_INITRAMFS
	depends on BR2_TARGET_ROOTFS_SQUASHFS
	help
	  Instead of carrying the whole root filesystem in the kernel
	  (unpacked into RAM at every boot, seconds for a few hundred
	  MB), the kernel carries a small early root filesystem
	  (sion-early-init and what it needs) and the system goes into
	  rootfs.squashfs, installed as sion/root/ID.sqfs on SIONDATA.
	  The early init mounts it with /data/overlay and a RAM layer
	  over it. "sion update" installs both files.

	  Needs the kernel to have squashfs, loop, overlayfs, tmpfs
	  xattrs and the boot disk's drivers built in.

endif

comment "sion-tools needs a toolchain w/ threads, dynamic library"
	depends on BR2_USE_MMU
	depends on BR2_PACKAGE_EFIVAR_ARCH_SUPPORTS
	depends on !BR2_TOOLCHAIN_HAS_THREADS || BR2_STATIC_LIBS
```
