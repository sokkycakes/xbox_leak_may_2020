## bootani/buildroot/Config.in
```kconfig
source "$BR2_EXTERNAL_BOOTANI_PATH/package/bootani/Config.in"
source "$BR2_EXTERNAL_BOOTANI_PATH/package/theseus/Config.in"
source "$BR2_EXTERNAL_BOOTANI_PATH/package/sion-tools/Config.in"
source "$BR2_EXTERNAL_BOOTANI_PATH/package/xbcompat/Config.in"
source "$BR2_EXTERNAL_BOOTANI_PATH/package/unicorn/Config.in"
source "$BR2_EXTERNAL_BOOTANI_PATH/package/box86/Config.in"
```

## bootani/buildroot/package/bootani/Config.in
```kconfig
config BR2_PACKAGE_BOOTANI
	bool "bootani"
	depends on BR2_INSTALL_LIBSTDCPP
	depends on BR2_TOOLCHAIN_HAS_THREADS
	depends on BR2_PACKAGE_HAS_LIBEGL
	depends on BR2_PACKAGE_HAS_LIBGBM
	select BR2_PACKAGE_LIBDRM
	select BR2_PACKAGE_ALSA_LIB
	select BR2_PACKAGE_ALSA_LIB_PCM
	help
	  The original Xbox boot animation and sound, drawn with
	  OpenGL 3.3 core straight to the display (DRM/KMS), with no
	  window system. Needs a Mesa driver with desktop OpenGL 3.3
	  (iris, radeonsi, softpipe, ...).

if BR2_PACKAGE_BOOTANI

config BR2_PACKAGE_BOOTANI_START_AT_BOOT
	bool "start at boot"
	default y
	help
	  Install /etc/init.d/S00bootani, which starts the animation
	  in the background as the first init script.

config BR2_PACKAGE_BOOTANI_ARGS
	string "arguments"
	default "--kms"
	depends on BR2_PACKAGE_BOOTANI_START_AT_BOOT
	help
	  Command line for bootani when started at boot. Useful
	  additions: --hold (keep the final logo up until the init
	  script is stopped), --short, --loop, --audio-device NAME,
	  --drm-device /dev/dri/cardN.

endif

comment "bootani needs a toolchain w/ C++, threads, and EGL + GBM (mesa3d)"
	depends on !BR2_INSTALL_LIBSTDCPP || !BR2_TOOLCHAIN_HAS_THREADS || \
		!BR2_PACKAGE_HAS_LIBEGL || !BR2_PACKAGE_HAS_LIBGBM
```

## bootani/buildroot/package/box86/Config.in
```kconfig
config BR2_PACKAGE_BOX86
	bool "box86"
	depends on BR2_arm
	depends on BR2_TOOLCHAIN_USES_GLIBC
	depends on BR2_TOOLCHAIN_HAS_THREADS
	help
	  box86, a Linux x86 userspace emulator for 32-bit ARM with a
	  dynamic recompiler. It runs the i386 build of xbcompat on a
	  Raspberry Pi, calling the Pi's own libc, SDL2 and GL.

	  https://github.com/ptitSeb/box86
```

## bootani/buildroot/package/sion-tools/Config.in
```kconfig
config BR2_PACKAGE_SION_TOOLS
	bool "sion-tools"
	depends on BR2_USE_MMU # openssh, avahi
	depends on BR2_TOOLCHAIN_HAS_THREADS # avahi, efivar
	depends on !BR2_STATIC_LIBS # avahi, efivar
	depends on BR2_PACKAGE_EFIVAR_ARCH_SUPPORTS
	select BR2_PACKAGE_OPENSSH
	select BR2_PACKAGE_OPENSSH_SERVER
	select BR2_PACKAGE_OPENSSH_KEY_UTILS
	select BR2_PACKAGE_AVAHI
	select BR2_PACKAGE_AVAHI_DAEMON
	select BR2_PACKAGE_WPA_SUPPLICANT
	select BR2_PACKAGE_WPA_SUPPLICANT_NL80211
	select BR2_PACKAGE_WPA_SUPPLICANT_WPA3
	select BR2_PACKAGE_WPA_SUPPLICANT_CLI
	select BR2_PACKAGE_IW
	select BR2_PACKAGE_WIRELESS_REGDB
	select BR2_PACKAGE_EFIBOOTMGR
	select BR2_PACKAGE_E2FSPROGS
	select BR2_PACKAGE_E2FSPROGS_RESIZE2FS
	select BR2_PACKAGE_UTIL_LINUX
	select BR2_PACKAGE_UTIL_LINUX_BINARIES # sfdisk, blkid
	select BR2_PACKAGE_UTIL_LINUX_PARTX
	help
	  Remote access and updates for a Sion machine:
	  - SSH (with SFTP) as root, over wired, USB or Wi-Fi Ethernet,
	    found on the network as <hostname>.local
	  - a persistent ext4 partition (SIONDATA) mounted on /data, with
	    an overlay copied over the root filesystem at boot
	  - "sion update": A/B updates of the boot image that boot the new
	    image once and keep it only if it comes up, otherwise the
	    machine falls back to the previous one

	  Settings come from sion/sion.conf on the boot disk's EFI
	  partition.

comment "sion-tools needs a toolchain w/ threads, dynamic library"
	depends on BR2_USE_MMU
	depends on BR2_PACKAGE_EFIVAR_ARCH_SUPPORTS
	depends on !BR2_TOOLCHAIN_HAS_THREADS || BR2_STATIC_LIBS
```

## bootani/buildroot/package/theseus/Config.in
```kconfig
config BR2_PACKAGE_THESEUS
	bool "theseus"
	depends on BR2_INSTALL_LIBSTDCPP
	depends on BR2_TOOLCHAIN_GCC_AT_LEAST_10 # bgfx: C++20
	depends on BR2_TOOLCHAIN_HAS_THREADS
	depends on !BR2_STATIC_LIBS # dlopen of libEGL
	depends on BR2_HOSTARCH = "x86_64" # bx ships genie as an x86_64 binary
	depends on BR2_PACKAGE_SDL2_KMSDRM
	depends on BR2_PACKAGE_MPV # also brings ffmpeg
	select BR2_PACKAGE_SDL2_MIXER
	select BR2_PACKAGE_FFMPEG_SWSCALE
	select BR2_PACKAGE_LIBCURL
	select BR2_PACKAGE_OPUS
	help
	  Theseus, a reconstruction of the original Xbox dashboard
	  (TeamUIX), built as its desktop "UIX Desktop" engine and
	  patched to render straight to the display through SDL's
	  KMSDRM driver and bgfx's OpenGL backend, with no X11 or
	  Wayland. Needs a Mesa driver with desktop OpenGL 3.3
	  (iris, radeonsi, softpipe, ...).

	  https://github.com/MrMilenko/Theseus

if BR2_PACKAGE_THESEUS

config BR2_PACKAGE_THESEUS_START_AT_BOOT
	bool "start after bootani"
	default y
	help
	  Install /etc/init.d/S99theseus, which waits for the boot
	  animation to finish and then runs the dashboard, restarting
	  it if it exits.

endif

comment "theseus needs SDL2 with KMSDRM, mpv, and a toolchain w/ C++, threads, gcc >= 10, dynamic library"
	depends on BR2_HOSTARCH = "x86_64"
	depends on !BR2_PACKAGE_SDL2_KMSDRM || !BR2_PACKAGE_MPV || \
		!BR2_INSTALL_LIBSTDCPP || !BR2_TOOLCHAIN_HAS_THREADS || \
		!BR2_TOOLCHAIN_GCC_AT_LEAST_10 || BR2_STATIC_LIBS
```

## bootani/buildroot/package/unicorn/Config.in
```kconfig
config BR2_PACKAGE_UNICORN
	bool "unicorn"
	depends on BR2_TOOLCHAIN_HAS_THREADS
	depends on BR2_USE_MMU
	help
	  Unicorn, QEMU's CPU emulator packaged as a library. Built
	  with only its x86 core, as a static library for xbcompat,
	  which runs Xbox code with it on hosts that aren't x86.

	  https://www.unicorn-engine.org/
```

## bootani/buildroot/package/xbcompat/Config.in
```kconfig
config BR2_PACKAGE_XBCOMPAT
	bool "xbcompat (Xbox boot animation and dashboard)"
	# x86_64: runs the 32-bit x86 code natively (IA32 emulation).
	# arm: 32-bit ARM (Raspberry Pi), runs it in Unicorn.
	depends on BR2_x86_64 || BR2_arm
	depends on !BR2_arm || (BR2_USE_MMU && BR2_USE_WCHAR && BR2_TOOLCHAIN_HAS_THREADS && !BR2_STATIC_LIBS)
	select BR2_PACKAGE_UNICORN if BR2_arm
	select BR2_PACKAGE_SDL2 if BR2_arm
	select BR2_PACKAGE_SDL2_KMSDRM if BR2_arm
	select BR2_PACKAGE_SDL2_OPENGLES if BR2_arm
	select BR2_PACKAGE_LIBGLVND if BR2_arm
	select BR2_PACKAGE_HOST_PYTHON3 if BR2_arm
	select BR2_PACKAGE_PYTHON3 if BR2_arm
	select BR2_PACKAGE_XBSYMBOLDATABASE if BR2_arm
	help
	  The original Xbox boot animation (the leak's ani2) and
	  dashboard (xboxdash.xbe), run by xbcompat, the compatibility
	  layer in xbcompat/ of this repository, straight on KMSDRM.

	  The boot animation replaces bootani at boot (bootani is
	  still there, and runs if xbcompat can't start). The
	  dashboard runs instead of Theseus when DASHBOARD=xbox (the
	  default, in /etc/default/dashboard or sion/sion.conf);
	  Theseus takes over if the Xbox dashboard keeps failing to
	  start.

	  xbcompat and the two titles are 32-bit programs with their
	  own userspace (glibc, SDL2, Mesa), built outside Buildroot
	  by xbcompat/tools/sion/bundle.sh into a tarball, which this
	  package unpacks into /opt/xbcompat.

	  On 32-bit ARM, xbcompat is built here from xbcompat/ in
	  this repository, and the titles come from a tarball made
	  by xbcompat/tools/pi/titles.sh.

if BR2_PACKAGE_XBCOMPAT

config BR2_PACKAGE_XBCOMPAT_BUNDLE
	string "bundle"
	depends on BR2_x86_64
	help
	  Path to xbcompat-sion.tar.gz from xbcompat/tools/sion/bundle.sh.

config BR2_PACKAGE_XBCOMPAT_TITLES
	string "titles"
	depends on BR2_arm
	help
	  Path to xbcompat-titles.tar.gz from xbcompat/tools/pi/titles.sh:
	  the boot animation, the dashboard's partition and their
	  library maps, unpacked into /opt/xbcompat.

config BR2_PACKAGE_XBCOMPAT_DASHBOARD
	string "dashboard at boot"
	default "xbox"
	help
	  "xbox" for the Xbox dashboard under xbcompat, "theseus"
	  for Theseus. Written to /etc/default/dashboard; DASHBOARD=
	  in the boot stick's sion/sion.conf overrides it.

endif
```

## bootani/buildroot/package/xbsymboldatabase/Config.in
```kconfig
config BR2_PACKAGE_XBSYMBOLDATABASE
	bool "XbSymbolDatabase command-line scanner"
	help
	  Native offline XDK library scanner used to prepare xbcompat HLE maps.
```

## qtopia-rgds/buildroot/configs/qemu_aarch64_qtopia_defconfig
```kconfig
# QEMU aarch64 virt test image for Qt Extended (stands in for the RG DS)
BR2_aarch64=y
BR2_cortex_a53=y
BR2_TOOLCHAIN_EXTERNAL=y
BR2_TOOLCHAIN_EXTERNAL_BOOTLIN=y
BR2_TOOLCHAIN_EXTERNAL_BOOTLIN_AARCH64_GLIBC_STABLE=y
BR2_TARGET_GENERIC_HOSTNAME="rgds"
BR2_TARGET_GENERIC_ISSUE="Qt Extended on RG DS (QEMU test)"
BR2_INIT_BUSYBOX=y
BR2_ROOTFS_DEVICE_CREATION_DYNAMIC_MDEV=y
BR2_ROOTFS_OVERLAY="$(BR2_EXTERNAL_QTOPIA_RGDS_PATH)/board/qemu-rgds/rootfs-overlay"
BR2_SYSTEM_DHCP="eth0"
BR2_LINUX_KERNEL=y
BR2_LINUX_KERNEL_CUSTOM_VERSION=y
BR2_LINUX_KERNEL_CUSTOM_VERSION_VALUE="6.18.7"
BR2_LINUX_KERNEL_USE_CUSTOM_CONFIG=y
BR2_LINUX_KERNEL_CUSTOM_CONFIG_FILE="board/qemu/aarch64-virt/linux.config"
BR2_LINUX_KERNEL_CONFIG_FRAGMENT_FILES="$(BR2_EXTERNAL_QTOPIA_RGDS_PATH)/board/qemu-rgds/linux.fragment"
BR2_LINUX_KERNEL_NEEDS_HOST_OPENSSL=y
BR2_TARGET_ROOTFS_EXT2=y
BR2_TARGET_ROOTFS_EXT2_4=y
BR2_TARGET_ROOTFS_EXT2_SIZE="1G"
# Qt Extended runtime deps
BR2_PACKAGE_ALSA_LIB=y
BR2_PACKAGE_ALSA_UTILS=y
BR2_PACKAGE_DBUS=y
BR2_PACKAGE_OPENSSL=y
BR2_PACKAGE_SQLITE=y
BR2_PACKAGE_LIBPNG=y
BR2_PACKAGE_JPEG=y
BR2_PACKAGE_ZLIB=y
BR2_PACKAGE_TSLIB=y
BR2_PACKAGE_LIBDRM=y
BR2_PACKAGE_LIBEVDEV=y
BR2_PACKAGE_EVTEST=y
BR2_PACKAGE_SPEEXDSP=y
BR2_PACKAGE_LIBVORBIS=y
BR2_PACKAGE_DEJAVU=y
BR2_PACKAGE_LIBGLIB2=y
BR2_PACKAGE_LIBXCRYPT=y
BR2_ROOTFS_POST_BUILD_SCRIPT="$(BR2_EXTERNAL_QTOPIA_RGDS_PATH)/board/qemu-rgds/post-build.sh"
BR2_PACKAGE_STRACE=y
BR2_TARGET_TZ_INFO=y
BR2_TARGET_TZ_ZONELIST="default"
BR2_TARGET_LOCALTIME="Etc/UTC"
```
